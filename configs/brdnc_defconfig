## configs/brdnc_defconfig
```kconfig
BR2_x86_64=y
BR2_TOOLCHAIN_BUILDROOT_VENDOR="brdnc"
BR2_TOOLCHAIN_BUILDROOT_GLIBC=y
BR2_TOOLCHAIN_BUILDROOT_CXX=y
BR2_TOOLCHAIN_BUILDROOT_FORTRAN=y
BR2_TARGET_GENERIC_HOSTNAME="brdnc"
BR2_TARGET_GENERIC_ISSUE="Welcome to BRDNC"
BR2_TARGET_GENERIC_PASSWD_SHA256=y
BR2_TARGET_GENERIC_ROOT_PASSWD="brdnc"
BR2_PACKAGE_BUSYBOX_SELINUX=y
BR2_PACKAGE_LZ4=y
BR2_PACKAGE_XZ=y
BR2_PACKAGE_ZIP=y
BR2_PACKAGE_NODEJS=y
BR2_PACKAGE_NODEJS_NPM=y
BR2_PACKAGE_LZO=y
BR2_PACKAGE_LIBSODIUM=y
BR2_PACKAGE_CJSON=y
BR2_PACKAGE_LIBXSLT=y
BR2_PACKAGE_ZLOG=y
BR2_PACKAGE_LIBCURL=y
BR2_PACKAGE_CURL=y
BR2_PACKAGE_LIBEVENT=y
BR2_PACKAGE_ICU=y
BR2_PACKAGE_READLINE=y
BR2_PACKAGE_SETOOLS=y
BR2_PACKAGE_INOTIFY_TOOLS=y
BR2_PACKAGE_NANO=y
```
